## main/Kconfig.projbuild
```kconfig
menu "Sensor Configuration"

    config I2C_MASTER_SCL_IO
        int "I2C master SCL GPIO"
        default 22
        help
            Select the GPIO number for the I2C master SCL line.

    config I2C_MASTER_SDA_IO
        int "I2C master SDA GPIO"
        default 21
        help
            Select the GPIO number for the I2C master SDA line.

    config I2C_MASTER_FREQ_HZ
        int "I2C master clock frequency"
        default 100000
        help
            Select the I2C master clock frequency in Hz.

endmenu
```
